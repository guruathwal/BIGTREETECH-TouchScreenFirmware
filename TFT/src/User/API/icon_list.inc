/**
* Icon Keywords Generation
* Usage: X_ICON(VALUE)
* 'VALUE' is the keyword name without the 'ICON_'
*
* Description: https://en.wikipedia.org/wiki/X_Macro
*/
//after changing/adding/removing an icon, change the ICON_FLASH_SIGN in Settings.h

X_ICON (HEAT)
X_ICON (MOVE)
X_ICON (HOME)
X_ICON (DISABLE_STEPPERS)
X_ICON (PRINT)
X_ICON (EXTRUDE)
X_ICON (FAN)
X_ICON (SETTINGS)
X_ICON (Z_FADE)
X_ICON (INC)
X_ICON (DEC)
X_ICON (NOZZLE)
X_ICON (BED)
X_ICON (CHAMBER)
X_ICON (1_DEGREE)
X_ICON (5_DEGREE)
X_ICON (10_DEGREE)
X_ICON (APPLY)
X_ICON (STOP)
X_ICON (BACK)
X_ICON (X_INC)
X_ICON (Y_INC)
X_ICON (Z_INC)
X_ICON (01_MM)
X_ICON (1_MM)
X_ICON (10_MM)
X_ICON (100_MM)
X_ICON (X_DEC)
X_ICON (Y_DEC)
X_ICON (Z_DEC)
X_ICON (FOLDER)
X_ICON (FILE)
X_ICON (PAGE_UP)
X_ICON (PAGE_DOWN)
X_ICON (PAUSE)
X_ICON (RESUME)
X_ICON (SLOW_SPEED)
X_ICON (NORMAL_SPEED)
X_ICON (FAST_SPEED)
X_ICON (E_1_MM)
X_ICON (E_5_MM)
X_ICON (E_10_MM)
X_ICON (E_100_MM)
X_ICON (E_200_MM)
X_ICON (E_1_PERCENT)
X_ICON (E_5_PERCENT)
X_ICON (E_10_PERCENT)
X_ICON (E_100_PERCENT)
X_ICON (ROTATE_UI)
X_ICON (LANGUAGE)
X_ICON (TOUCHSCREEN_ADJUST)
X_ICON (MORE)
X_ICON (SCREEN_INFO)
X_ICON (MARLIN_MODE)
X_ICON (DISCONNECT)
X_ICON (BAUD_RATE)
X_ICON (PERCENTAGE)
X_ICON (BABYSTEP)
X_ICON (001_MM)
X_ICON (ONBOARD_SD)
X_ICON (ONTFT_SD)
X_ICON (U_DISK)
X_ICON (MARLIN)
X_ICON (BIGTREETECH)
X_ICON (GCODE)
X_ICON (SCREEN_SETTINGS)
X_ICON (MACHINE_SETTINGS)
X_ICON (FEATURE_SETTINGS)
X_ICON (EEPROM_SAVE)
X_ICON (EEPROM_RESTORE)
X_ICON (EEPROM_RESET)
X_ICON (SOUND)
X_ICON (SHUT_DOWN)
X_ICON (RGB_SETTINGS)
X_ICON (RGB_RED)
X_ICON (RGB_GREEN)
X_ICON (RGB_BLUE)
X_ICON (RGB_WHITE)
X_ICON (RGB_OFF)
X_ICON (CUSTOM)
X_ICON (PARAMETER)
X_ICON (RESET_VALUE)
X_ICON (PRINTING_NOZZLE)
X_ICON (PRINTING_BED)
X_ICON (PRINTING_TIMER)
X_ICON (PRINTING_ZLAYER)
X_ICON (PRINTING_SPEED)
X_ICON (PRINTING_FLOW)
X_ICON (MAINMENU)
X_ICON (HOME_MOVE)
X_ICON (HEAT_FAN)
X_ICON (COOLDOWN)
X_ICON (NOZZLE_DOWN)
X_ICON (NOZZLE_UP)
X_ICON (CONNECTION_SETTINGS)
X_ICON (CASE_LIGHT)
X_ICON (BRIGHTNESS)

X_ICON (PAD_DOSE20)
X_ICON (PAD_DOSE50)
X_ICON (PAD_FLOW)
X_ICON (PAD_FLUSH_3)
X_ICON (PAD_FLUSH_10)
X_ICON (PAD_MENU)
X_ICON (PAD_MOVE)
X_ICON (PAD_PRINT)
X_ICON (PAD_PUMP)
X_ICON (PAD_PUMPOFF)
X_ICON (PAD_SPEED)
X_ICON (PAD_Z_INC_10)
X_ICON (PAD_Z_DEC_10)
//after changing/adding/removing an icon, change the ICON_FLASH_SIGN in Settings.h
